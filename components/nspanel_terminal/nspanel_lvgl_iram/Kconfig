## components/nspanel_terminal/nspanel_lvgl_iram/Kconfig
```kconfig
menu "NSPanel renderer placement"
config NSPANEL_LVGL_IRAM
    bool "Place selected LVGL software renderer objects in internal RAM"
    default n
endmenu
```
